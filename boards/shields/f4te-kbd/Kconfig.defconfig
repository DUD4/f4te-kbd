## boards/shields/f4te-kbd/Kconfig.defconfig
```kconfig
if SHIELD_F4TE_KBD_LEFT

config ZMK_KEYBOARD_NAME
    default "F4te KBD"

config ZMK_SPLIT_ROLE_CENTRAL
    default y

endif

if SHIELD_F4TE_KBD_LEFT || SHIELD_F4TE_KBD_RIGHT

config ZMK_SPLIT
    default y

endif
```

## boards/shields/f4te-kbd/Kconfig.shield
```kconfig
# Copyright (c) 2020 Pete Johanson
# SPDX-License-Identifier: MIT

config SHIELD_F4TE_KBD_LEFT
    def_bool $(shields_list_contains,f4te-kbd_left)

config SHIELD_F4TE_KBD_RIGHT
    def_bool $(shields_list_contains,f4te-kbd_right)
```
